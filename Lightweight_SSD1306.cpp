/* Lightweight_SSD1306.cpp
  this file is part of Lightweight_SSD1306 library

  written by Siavash alizadeh (TECFIELD)
  https://github.com/Tecfield-SIA
  www.linkedin.com/in/siavash-alizadeh-tecfield

  The Lightweight_SSD1306 library is inspired by 
  the Adafruit_SSD1306 library but is not a direct copy or modification of it.
  https://github.com/adafruit/Adafruit_SSD1306
*/


#include "Lightweight_SSD1306.h"
#include <Arduino.h>


const uint8_t Lightweight_SSD1306::font[] PROGMEM = {
  0x00, 0x00, 0x00, 0x00, 0x00,  // (space)
  0x00, 0x00, 0x5F, 0x00, 0x00,  // !
  0x00, 0x07, 0x00, 0x07, 0x00,  // "
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  0x08, 0x04, 0x08, 0x10, 0x08,  // ~
};


Lightweight_SSD1306::Lightweight_SSD1306(uint8_t width, uint8_t height)
  : _width(width), _height(height), _i2c_addr(SSD1306_I2C_ADDRESS), _wire(&Wire),
    _textSize(1), _textColor(1), _cursorX(0), _cursorY(0) {
  memset(_buffer, 0, sizeof(_buffer));
}


bool Lightweight_SSD1306::begin(uint8_t i2c_addr, TwoWire *wire) {
  _i2c_addr = i2c_addr;
  _wire = wire;

  _wire->begin();
  _wire->beginTransmission(_i2c_addr);
  if (_wire->endTransmission() != 0) {
    return false;
  }

  sendCommand(0xAE);
  sendCommand(0xD5);
  sendCommand(0x80);
  sendCommand(0xA8);
  sendCommand(_height - 1);
  sendCommand(0xD3);
  sendCommand(0x00);
  sendCommand(0x40 | 0x00);
  sendCommand(0x8D);
  sendCommand(0x14);
  sendCommand(0x20);
  sendCommand(0x00);
  sendCommand(0xA1);
  sendCommand(0xC8);
  sendCommand(0xDA);
  sendCommand(0x12);
  sendCommand(0x81);
  sendCommand(0xCF);
  sendCommand(0xD9);
  sendCommand(0xF1);
  sendCommand(0xDB);
  sendCommand(0x40);
  sendCommand(0xA4);
  sendCommand(0xA6);
  sendCommand(0xAF);

  clearDisplay();
  display();
  return true;
}


void Lightweight_SSD1306::clearDisplay() {
  memset(_buffer, 0, sizeof(_buffer));
}


void Lightweight_SSD1306::display() {
  for (uint8_t page = 0; page < 8; page++) {
    sendCommand(0xB0 + page);
    sendCommand(0x00);
    sendCommand(0x10);

    _wire->beginTransmission(_i2c_addr);
    _wire->write(0x40);
    for (uint16_t i = 0; i < 128; i++) {
      _wire->write(_buffer[i + page * 128]);
    }
    _wire->endTransmission();
  }
}


void Lightweight_SSD1306::setTextSize(uint8_t size) {
  _textSize = size;
}


void Lightweight_SSD1306::setTextColor(uint16_t color) {
  _textColor = color;
}


void Lightweight_SSD1306::setCursor(int16_t x, int16_t y) {
  _cursorX = x;
  _cursorY = y;
}


void Lightweight_SSD1306::print(const char *text) {
  while (*text) {
    drawChar(_cursorX, _cursorY, *text, _textColor, _textSize);
    _cursorX += 6 * _textSize;
    text++;
  }
}


void Lightweight_SSD1306::print(int number) {
  char buffer[12];
  sprintf(buffer, "%d", number);
  print(buffer);
}


void Lightweight_SSD1306::print(float number) {
  String str = String(number, 2);
  print(str.c_str());
}


void Lightweight_SSD1306::drawChar(int16_t x, int16_t y, char c, uint16_t color, uint8_t size) {
  if (c < 32 || c > 126) {
    return;
  }

  uint8_t charIndex = c - 32;

  for (int8_t i = 0; i < 5; i++) {
    uint8_t line = pgm_read_byte(&font[charIndex * 5 + i]);
    for (int8_t j = 0; j < 8; j++) {
      if (line & 0x1) {
        if (size == 1) {
          drawPixel(x + i, y + j, color);
        } else {
          fillRect(x + i * size, y + j * size, size, size, color);
        }
      }
      line >>= 1;
    }
  }
}


void Lightweight_SSD1306::drawBitmap(int16_t x, int16_t y, const uint8_t *bitmap, int16_t w, int16_t h, uint16_t color) {
  for (int16_t j = 0; j < h; j++) {
    for (int16_t i = 0; i < w; i++) {
      if (pgm_read_byte(&bitmap[j * (w / 8) + (i / 8)]) & (1 << (7 - (i % 8)))) {
        drawPixel(x + i, y + j, color);
      }
    }
  }
}


void Lightweight_SSD1306::fillRect(int16_t x, int16_t y, int16_t w, int16_t h, uint16_t color) {
  for (int16_t i = x; i < x + w; i++) {
    for (int16_t j = y; j < y + h; j++) {
      drawPixel(i, j, color);
    }
  }
}


void Lightweight_SSD1306::drawLine(int16_t x0, int16_t y0, int16_t x1, int16_t y1, uint16_t color) {
  int16_t dx = abs(x1 - x0), sx = x0 < x1 ? 1 : -1;
  int16_t dy = -abs(y1 - y0), sy = y0 < y1 ? 1 : -1;
  int16_t err = dx + dy, e2;

  while (true) {
    drawPixel(x0, y0, color);
    if (x0 == x1 && y0 == y1) break;
    e2 = 2 * err;
    if (e2 >= dy) {
      err += dy;
      x0 += sx;
    }
    if (e2 <= dx) {
      err += dx;
      y0 += sy;
    }
  }
}


void Lightweight_SSD1306::drawRect(int16_t x, int16_t y, int16_t w, int16_t h, uint16_t color) {
  drawLine(x, y, x + w, y, color);
  drawLine(x + w, y, x + w, y + h, color);
  drawLine(x + w, y + h, x, y + h, color);
  drawLine(x, y + h, x, y, color);
}


void Lightweight_SSD1306::drawPixel(int16_t x, int16_t y, uint16_t color) {
  if (x >= 0 && x < _width && y >= 0 && y < _height) {
    if (color) {
      _buffer[x + (y / 8) * _width] |= (1 << (y % 8));
    } else {
      _buffer[x + (y / 8) * _width] &= ~(1 << (y % 8));
    }
  }
}


void Lightweight_SSD1306::sendCommand(uint8_t command) {
  _wire->beginTransmission(_i2c_addr);
  _wire->write(0x00);
  _wire->write(command);
  _wire->endTransmission();
}


void Lightweight_SSD1306::sendData(uint8_t *data, size_t size) {
  _wire->beginTransmission(_i2c_addr);
  _wire->write(0x40);
  for (size_t i = 0; i < size; i++) {
    _wire->write(data[i]);
  }
  _wire->endTransmission();
}
